/********************************************************************************************
**文件说明:		超声波壁障驱动文件
**版权归属:		EMO--E梦电子
**创 建 人:		whble
**版    本:		1.0V
**淘	宝:		http://taobao.xiangyunzone.com
**论    坛:		http://www.honeygeek.org/
**创建日期:		2013-7-25
*********************************************************************************************
**修 改 人:
**修改说明:
**修改版本:		
********************************************************************************************/

/*********************************公共头文件************************************************/
#include "define.h"

/*********************************全局变量**************************************************/
#define uble double

uble th=0;
uble tl=0;
uble time=0;
unsigned char key_stime_counter,timeT_counter;
uchar n=1,right=1,left=1;
bit key_stime_ok;
uble distance;

/********************************************************************************************
**函数名称:		void DelayUs(unsigned char us)
**函数功能:		微秒级延时函数
**输入参数:		us 延时时间
**输出参数:		none
**返 回 值:		none
**创 建 人:		whble
**创建日期:		2013-7-25
*********************************************************************************************
**修 改 人:		
**修改说明:		为了精确控制超声波时间，区别于function中延时函数
********************************************************************************************/
 void DelayUs(unsigned char us)
{
uchar uscnt;
 uscnt=us>>1;
 while(--uscnt);
}

/********************************************************************************************
**函数名称:		void delay2(uint ms)
**函数功能:		毫秒级延时函数
**输入参数:		ms 延时时间
**输出参数:		none
**返 回 值:		none
**创 建 人:		whble
**创建日期:		2013-7-25
*********************************************************************************************
**修 改 人:
**修改说明:		为了精确控制超声波时间，区别于function中延时函数
********************************************************************************************/
void delay2(uint ms)
{
 while(--ms)
{
 DelayUs(250);
 DelayUs(250);
 DelayUs(250);
 DelayUs(250);
}
}

/********************************************************************************************
**函数名称:		void timer0(void) interrupt 1 using 0 
**函数功能:		定时器0中断服务函数
**输入参数:		none
**输出参数:		none
**返 回 值:		none
**创 建 人:		whble
**创建日期:		2013-7-25
*********************************************************************************************
**修 改 人:
**修改说明:		
********************************************************************************************/
void timer0(void) interrupt 1 using 0 
{
TH0=0xff; 
TL0=0x9c;      												//定时0.1mS 

if (++key_stime_counter>=200)
{
	key_stime_counter=0;
	control_signal=1;
	key_stime_ok = 1;               						// 20ms到 
	timeT_counter=0;
}

if (key_stime_ok&&(++timeT_counter>=hight_votage))
{
	key_stime_ok=0;
	timeT_counter=0;
	control_signal=0;              							// hight_votage*0.1ms到 
}
}

/********************************************************************************************
**函数名称:		void chaoshengbo()
**函数功能:		超声波测距函数
**输入参数:		none
**输出参数:		none
**返 回 值:		none
**创 建 人:		whble
**创建日期:		2013-7-25
*********************************************************************************************
**修 改 人:
**修改说明:		
********************************************************************************************/
void chaoshengbo()
{
	 Trig=0;
	 DelayUs(5);
	 Trig=1;
	 DelayUs(20); 
	 while(!Echo)if(flag!=5)break;; 
	 TR1=1;
 }

/********************************************************************************************
**函数名称:		void ex_1() interrupt 2	
**函数功能:		外部中断1 实现超声波的中断服务
**输入参数:		none
**输出参数:		none
**返 回 值:		none
**创 建 人:		whble
**创建日期:		2013-7-25
*********************************************************************************************
**修 改 人:
**修改说明:		
********************************************************************************************/
void ex_1() interrupt 2
 {
	TR1=0;
	th=TH1;
	tl=TL1; 	
	TH1=0;
	TL1=0;
	time=th*256+tl;
	distance=time*0.172;	  								//毫米
	if(distance<150.0)										//安全距离判断
	{  
		n=0;												//不安全
	}
	else
	{	
		n=1;												//安全
	}
	 
 }
/********************************************************************************************
**函数名称:		void Ultrasonic_mode()
**函数功能:		超声波壁障函数
**输入参数:		none
**输出参数:		none
**返 回 值:		none
**创 建 人:		whble
**创建日期:		2013-7-25
*********************************************************************************************
**修 改 人:
**修改说明:		
********************************************************************************************/ 
void Ultrasonic_mode()
{
	control_signal=0;	 
	TMOD=0x11;    											//定时器T0/T1工作方式为	模式一
	EX1=1;													//外部中断1允许
	
	IT1=1;		 											//外部中断1，下降沿触发方式 ,0为低电平触发
	
	ET1=0;		 											//定时器、计数器1 用于计时测量超声波时间 允许计数器溢出中断；0为禁止 
	ET0=1;		 											//定时器、计数器0 用于产生pwm控制舵机 允许计数器溢出中断；0为禁止 
	
	TH1=0;													//装载初值
	TL1=0;	  
	
	TH0=0xff; 
	TL0=0x9c;      											//定时0.1mS   
	
	TR0=1;  												//定时器0 控制位	
	EA=1;
	hight_votage=15;										//舵机初始角度为0
	while(1)
		{
		if(flag!=5)break;				
		chaoshengbo();
		delay2(20);
		if(n==1) 											//安全，则前进
		{ 
		    Motor_GoHead();
		    delay2(100);
		}		
		if(n==0)											//不安全
		{
			Motor_Stop();
			n=1;
	    	hight_votage+=6;								//舵机左摆
        	delay2(400);
        	chaoshengbo();									//执行超声波测距，
        	delay2(20);
   	    	left=n;											//左边安全标志
   	    	n=1;
        	hight_votage-=6;								//舵机居中
  	    	delay2(400);
	    	hight_votage-=6;								//舵机右摆
	    	delay2(400);
	    	chaoshengbo();									//执行超声波测距
   	    	delay2(20);
	    	right=n;										//右边安全标准
	    	hight_votage+=6;								//舵机居中
	    	delay2(400);
        	n=1;
	   if(left==1)											//左边安全左转
		{
			Motor_GoLeftFast();
			delay2(400);
		}
	   else if(left==0&&right==1)							//左边不安全，右边安全右转
		{
			Motor_GoRightFast();
			delay2(400);
		}
       else													//左右不安全，后退后，左转
   		{
   			Motor_GoBack();
   			delay2(800);
   			Motor_GoRightFast();
   			delay2(400);
   		}
   	   } 
	    }
}				

