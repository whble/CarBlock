/********************************************************************************************
**文件说明:		1602驱动程序文件
**版权归属:		EMO--E梦电子
**创 建 人:		whble
**版    本:		1.0V
**淘	宝:		http://taobao.xiangyunzone.com
**论    坛:		http://www.honeygeek.org/
**创建日期:		2013-7-25
*********************************************************************************************
**修 改 人:
**修改说明:
**修改版本:		
********************************************************************************************/

/*********************************公共头文件************************************************/
#include "define.h"

/*********************************全局变量**************************************************/
#define Busy  0x80 											//用于检测LCM状态字中的Busy标识

void WriteDataLCD(uchar WDLCD);								//写数据
void WriteCommandLCD(uchar WCLCD,BuysC);					//写命令
unsigned char ReadDataLCD(void);							//读数据
unsigned char ReadStatusLCD(void);							//读状态
void LCDInit(void);											//初始化
void DisplayOneChar(uchar X, uchar Y, uchar DData);			//相应坐标显示字节内容
void DisplayListChar(uchar X, char Y, uchar code *DData);	//相应坐标开始显示一串内容

/********************************************************************************************
**函数名称:		lic_init()
**函数功能:		1602液晶初始化
**输入参数:		none
**输出参数:		none
**返 回 值:		none
**创 建 人:		whble
**创建日期:		2013-7-25
*********************************************************************************************
**修 改 人:
**修改说明:
********************************************************************************************/
void lcd_init()
{
	LCD = 0X00;
	WriteCommandLCD(0x38,0);   								//3次设置显示模式，不检测忙信号
	delay_ms(5);
	WriteCommandLCD(0x38,0);
	delay_ms(5);
	WriteCommandLCD(0x38,0);
	delay_ms(5);
	WriteCommandLCD(0x38,1); 								//显示模式设置,开始要求每次检测忙信号
 	WriteCommandLCD(0x08,1); 								//关闭显示
 	WriteCommandLCD(0x01,1); 								//显示清屏
 	WriteCommandLCD(0x06,1); 								//显示光标移动设置
 	WriteCommandLCD(0x0C,1); 								//显示开及光标设置
		
}
/********************************************************************************************
**函数名称:		WriteDataLCD(uchar WDLCD)
**函数功能:		写数据函数
**输入参数:		uchar WDLCD 写入数据
**输出参数:		none
**返 回 值:		none
**创 建 人:		whble
**创建日期:		2013-7-25
*********************************************************************************************
**修 改 人:
**修改说明:
********************************************************************************************/
void WriteDataLCD(uchar WDLCD)
{
	ReadStatusLCD(); 										//检测忙
	RS=1;
	RW=0;
	LCD=WDLCD;
	_nop_();
	LCDEN = 0;
	LCDEN = 1;
}
/********************************************************************************************
**函数名称:		WriteCommandLCD(uchar WCLCD,BuysC)
**函数功能:		写指令函数
**输入参数:		uchar WCLCD写入指令,BuysC 忙标志
**输出参数:		none
**返 回 值:		none
**创 建 人:		whble
**创建日期:		2013-7-25
*********************************************************************************************
**修 改 人:
**修改说明:
********************************************************************************************/
void WriteCommandLCD(uchar WCLCD,BuysC)
{
	if(BuysC)
		ReadStatusLCD(); 									//BuysC为0时忽略忙检测
	RS=0;
	RW=0;
	LCD = WCLCD;
	_nop_();
	LCDEN = 0;
	LCDEN = 1;
}
/********************************************************************************************
**函数名称:		unsigned char ReadDataLCD(void)
**函数功能:		读数据函数
**输入参数:		none
**输出参数:		none
**返 回 值:		LCD 数据
**创 建 人:		whble
**创建日期:		2013-7-25
*********************************************************************************************
**修 改 人:
**修改说明:
********************************************************************************************/
unsigned char ReadDataLCD(void)
{
 	RS = 1; 
 	RW = 1;
 	LCDEN = 0;
 	_nop_();
 	LCDEN = 1;
 	return(LCD);
}
/********************************************************************************************
**函数名称:		unsigned char ReadStatusLCD(void)
**函数功能:		读状态函数
**输入参数:		none
**输出参数:		none
**返 回 值:		LCD
**创 建 人:		whble
**创建日期:		2013-7-25
*********************************************************************************************
**修 改 人:
**修改说明:
********************************************************************************************/
unsigned char ReadStatusLCD(void)
{
 	LCD = 0xFF; 
 	RS = 0;
 	RW = 1;
 	LCDEN = 0;
 	_nop_();
 	LCDEN = 1;
 	while (LCD & Busy); 									//检测忙信号
 	return(LCD);
}
/********************************************************************************************
**函数名称:		DisplayOneChar(unsigned char X, unsigned char Y, unsigned char DData)
**函数功能:		指定位置写入单个数据
**输入参数:		unsigned char X 为横坐标, unsigned char Y为显示行, unsigned char DData为数据
**输出参数:		none
**返 回 值:		none
**创 建 人:		whble
**创建日期:		2013-7-25
*********************************************************************************************
**修 改 人:
**修改说明:
********************************************************************************************/	
void DisplayOneChar(unsigned char X, unsigned char Y, unsigned char DData)
{	
 	Y &= 0x1;
 	X &= 0xF; 
	if(Y)
		X |=  0x40;
	X |=  0x80;
	WriteCommandLCD(X, 0); 									//这里不检测忙信号，发送地址码
 	WriteDataLCD(DData);
}
/********************************************************************************************
**函数名称:		void DisplayListChar(uchar X, uchar Y, uchar code *DData)
**函数功能:		指定位置写入多个数据
**输入参数:		unsigned char X 为横坐标, unsigned char Y为显示行, unsigned code *DData为数据
**输出参数:		none
**返 回 值:		none
**创 建 人:		whble
**创建日期:		2013-7-25
*********************************************************************************************
**修 改 人:
**修改说明:
********************************************************************************************/	
void DisplayListChar(uchar X, uchar Y, uchar code *DData)
{
 	uchar i;
	i = 0;
 	Y &= 0x1;
 	X &= 0xF; 												//限制X不能大于15，Y不能大于1
 	while (DData[i]>=0x20)									//若到达字串尾则退出(0x20 == 32 既ascii中前32位为非显示字符)
	{ 
   		if (X <= 0xF){ 										//X坐标应小于0xF
     		DisplayOneChar(X, Y, DData[i]); 				//显示单个字符
     		i++;
     		X++;
    	}
  	}
}
//endfile
